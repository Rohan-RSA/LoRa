## build/nrf7002dk/nrf5340/cpuapp/LoRa/Kconfig/soc/Kconfig
```kconfig
# Load Zephyr SoC Kconfig descriptions.
osource "C:/Projects/Github/nordic_workspace/external/zephyr/soc/xlnx/zynqmp/Kconfig"
osource "C:/Projects/Github/nordic_workspace/external/zephyr/soc/xlnx/zynq7000/Kconfig"
osource "C:/Projects/Github/nordic_workspace/external/zephyr/soc/xen/Kconfig"
osource "C:/Projects/Github/nordic_workspace/external/zephyr/soc/wch/ch32v00x/Kconfig"
osource "C:/Projects/Github/nordic_workspace/external/zephyr/soc/ti/simplelink/Kconfig"
osource "C:/Projects/Github/nordic_workspace/external/zephyr/soc/ti/lm3s6965/Kconfig"
osource "C:/Projects/Github/nordic_workspace/external/zephyr/soc/ti/k3/Kconfig"
osource "C:/Projects/Github/nordic_workspace/external/zephyr/soc/telink/tlsr/Kconfig"
osource "C:/Projects/Github/nordic_workspace/external/zephyr/soc/starfive/jh71xx/Kconfig"
osource "C:/Projects/Github/nordic_workspace/external/zephyr/soc/st/stm32/Kconfig"
osource "C:/Projects/Github/nordic_workspace/external/zephyr/soc/snps/qemu_arc/Kconfig"
osource "C:/Projects/Github/nordic_workspace/external/zephyr/soc/snps/nsim/arc_v/Kconfig"
osource "C:/Projects/Github/nordic_workspace/external/zephyr/soc/snps/nsim/arc_classic/Kconfig"
osource "C:/Projects/Github/nordic_workspace/external/zephyr/soc/snps/hsdk4xd/Kconfig"
osource "C:/Projects/Github/nordic_workspace/external/zephyr/soc/snps/hsdk/Kconfig"
osource "C:/Projects/Github/nordic_workspace/external/zephyr/soc/snps/emsk/Kconfig"
osource "C:/Projects/Github/nordic_workspace/external/zephyr/soc/snps/emsdp/Kconfig"
osource "C:/Projects/Github/nordic_workspace/external/zephyr/soc/snps/arc_iot/Kconfig"
osource "C:/Projects/Github/nordic_workspace/external/zephyr/soc/silabs/Kconfig"
osource "C:/Projects/Github/nordic_workspace/external/zephyr/soc/sifive/sifive_freedom/Kconfig"
osource "C:/Projects/Github/nordic_workspace/external/zephyr/soc/sensry/Kconfig"
osource "C:/Projects/Github/nordic_workspace/external/zephyr/soc/rockchip/Kconfig"
osource "C:/Projects/Github/nordic_workspace/external/zephyr/soc/renode/riscv_virtual/Kconfig"
osource "C:/Projects/Github/nordic_workspace/external/zephyr/soc/renode/cortex_r8_virtual/Kconfig"
osource "C:/Projects/Github/nordic_workspace/external/zephyr/soc/renesas/smartbond/Kconfig"
osource "C:/Projects/Github/nordic_workspace/external/zephyr/soc/renesas/rzt2m/Kconfig"
osource "C:/Projects/Github/nordic_workspace/external/zephyr/soc/renesas/rz/Kconfig"
osource "C:/Projects/Github/nordic_workspace/external/zephyr/soc/renesas/rcar/Kconfig"
osource "C:/Projects/Github/nordic_workspace/external/zephyr/soc/renesas/ra/Kconfig"
osource "C:/Projects/Github/nordic_workspace/external/zephyr/soc/realtek/ec/Kconfig"
osource "C:/Projects/Github/nordic_workspace/external/zephyr/soc/raspberrypi/rpi_pico/Kconfig"
osource "C:/Projects/Github/nordic_workspace/external/zephyr/soc/quicklogic/eos_s3/Kconfig"
osource "C:/Projects/Github/nordic_workspace/external/zephyr/soc/qemu/virt_riscv/Kconfig"
osource "C:/Projects/Github/nordic_workspace/external/zephyr/soc/qemu/malta/Kconfig"
osource "C:/Projects/Github/nordic_workspace/external/zephyr/soc/openisa/rv32m1/Kconfig"
osource "C:/Projects/Github/nordic_workspace/external/zephyr/soc/nxp/s32/Kconfig"
osource "C:/Projects/Github/nordic_workspace/external/zephyr/soc/nxp/rw/Kconfig"
osource "C:/Projects/Github/nordic_workspace/external/zephyr/soc/nxp/mcx/Kconfig"
osource "C:/Projects/Github/nordic_workspace/external/zephyr/soc/nxp/lpc/Kconfig"
osource "C:/Projects/Github/nordic_workspace/external/zephyr/soc/nxp/layerscape/Kconfig"
osource "C:/Projects/Github/nordic_workspace/external/zephyr/soc/nxp/kinetis/Kconfig"
osource "C:/Projects/Github/nordic_workspace/external/zephyr/soc/nxp/imxrt/Kconfig"
osource "C:/Projects/Github/nordic_workspace/external/zephyr/soc/nxp/imx/Kconfig"
osource "C:/Projects/Github/nordic_workspace/external/zephyr/soc/nuvoton/numicro/Kconfig"
osource "C:/Projects/Github/nordic_workspace/external/zephyr/soc/nuvoton/numaker/Kconfig"
osource "C:/Projects/Github/nordic_workspace/external/zephyr/soc/nuvoton/npcx/Kconfig"
osource "C:/Projects/Github/nordic_workspace/external/zephyr/soc/nuvoton/npcm/Kconfig"
osource "C:/Projects/Github/nordic_workspace/external/zephyr/soc/nordic/Kconfig"
osource "C:/Projects/Github/nordic_workspace/external/zephyr/soc/neorv32/Kconfig"
osource "C:/Projects/Github/nordic_workspace/external/zephyr/soc/native/inf_clock/Kconfig"
osource "C:/Projects/Github/nordic_workspace/external/zephyr/soc/microchip/miv/Kconfig"
osource "C:/Projects/Github/nordic_workspace/external/zephyr/soc/microchip/mec/Kconfig"
osource "C:/Projects/Github/nordic_workspace/external/zephyr/soc/mediatek/mt8xxx/Kconfig"
osource "C:/Projects/Github/nordic_workspace/external/zephyr/soc/lowrisc/opentitan/Kconfig"
osource "C:/Projects/Github/nordic_workspace/external/zephyr/soc/litex/litex_vexriscv/Kconfig"
osource "C:/Projects/Github/nordic_workspace/external/zephyr/soc/ite/ec/Kconfig"
osource "C:/Projects/Github/nordic_workspace/external/zephyr/soc/intel/raptor_lake/Kconfig"
osource "C:/Projects/Github/nordic_workspace/external/zephyr/soc/intel/lakemont/Kconfig"
osource "C:/Projects/Github/nordic_workspace/external/zephyr/soc/intel/intel_socfpga_std/Kconfig"
osource "C:/Projects/Github/nordic_workspace/external/zephyr/soc/intel/intel_socfpga/Kconfig"
osource "C:/Projects/Github/nordic_workspace/external/zephyr/soc/intel/intel_niosv/Kconfig"
osource "C:/Projects/Github/nordic_workspace/external/zephyr/soc/intel/intel_ish/Kconfig"
osource "C:/Projects/Github/nordic_workspace/external/zephyr/soc/intel/intel_adsp/Kconfig"
osource "C:/Projects/Github/nordic_workspace/external/zephyr/soc/intel/elkhart_lake/Kconfig"
osource "C:/Projects/Github/nordic_workspace/external/zephyr/soc/intel/atom/Kconfig"
osource "C:/Projects/Github/nordic_workspace/external/zephyr/soc/intel/apollo_lake/Kconfig"
osource "C:/Projects/Github/nordic_workspace/external/zephyr/soc/intel/alder_lake/Kconfig"
osource "C:/Projects/Github/nordic_workspace/external/zephyr/soc/infineon/cat3/Kconfig"
osource "C:/Projects/Github/nordic_workspace/external/zephyr/soc/infineon/cat1b/Kconfig"
osource "C:/Projects/Github/nordic_workspace/external/zephyr/soc/infineon/cat1a/Kconfig"
osource "C:/Projects/Github/nordic_workspace/external/zephyr/soc/gd/gd32/Kconfig"
osource "C:/Projects/Github/nordic_workspace/external/zephyr/soc/gaisler/leon3/Kconfig"
osource "C:/Projects/Github/nordic_workspace/external/zephyr/soc/gaisler/gr716a/Kconfig"
osource "C:/Projects/Github/nordic_workspace/external/zephyr/soc/espressif/Kconfig"
osource "C:/Projects/Github/nordic_workspace/external/zephyr/soc/ene/kb1200/Kconfig"
osource "C:/Projects/Github/nordic_workspace/external/zephyr/soc/efinix/sapphire/Kconfig"
osource "C:/Projects/Github/nordic_workspace/external/zephyr/soc/cdns/xtensa_sample_controller/Kconfig"
osource "C:/Projects/Github/nordic_workspace/external/zephyr/soc/cdns/sample_controller32/Kconfig"
osource "C:/Projects/Github/nordic_workspace/external/zephyr/soc/cdns/dc233c/Kconfig"
osource "C:/Projects/Github/nordic_workspace/external/zephyr/soc/brcm/bcmvk/Kconfig"
osource "C:/Projects/Github/nordic_workspace/external/zephyr/soc/brcm/bcm2712/Kconfig"
osource "C:/Projects/Github/nordic_workspace/external/zephyr/soc/brcm/bcm2711/Kconfig"
osource "C:/Projects/Github/nordic_workspace/external/zephyr/soc/atmel/sam0/Kconfig"
osource "C:/Projects/Github/nordic_workspace/external/zephyr/soc/atmel/sam/Kconfig"
osource "C:/Projects/Github/nordic_workspace/external/zephyr/soc/aspeed/Kconfig"
osource "C:/Projects/Github/nordic_workspace/external/zephyr/soc/arm/Kconfig"
osource "C:/Projects/Github/nordic_workspace/external/zephyr/soc/arm/beetle/Kconfig"
osource "C:/Projects/Github/nordic_workspace/external/zephyr/soc/andestech/Kconfig"
osource "C:/Projects/Github/nordic_workspace/external/zephyr/soc/amd/acp_6_0/Kconfig"
osource "C:/Projects/Github/nordic_workspace/external/zephyr/soc/ambiq/Kconfig"
osource "C:/Projects/Github/nordic_workspace/external/zephyr/soc/altr/zephyr_nios2f/Kconfig"
osource "C:/Projects/Github/nordic_workspace/external/zephyr/soc/altr/qemu_nios2/Kconfig"
osource "C:/Projects/Github/nordic_workspace/external/zephyr/soc/adi/max32/Kconfig"
osource "C:/Projects/Github/nordic_workspace/external/nrf/soc/nordic/Kconfig"
```
